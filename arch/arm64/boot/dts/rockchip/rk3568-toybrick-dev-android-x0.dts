// SPDX-License-Identifier: (GPL-2.0+ OR MIT)
/*
 * Copyright (c) 2020 Rockchip Electronics Co., Ltd.
 *
 */

#include "rk3568-toybrick.dtsi"
#include "rk3568-android.dtsi"
/ {
	compatible = "rockchip,rk3568-toybrick-dev-android-x0","rockchip,rk3568";
};

