// SPDX-License-Identifier: (GPL-2.0+ OR MIT)
/*
 * Copyright (c) 2020 Rockchip Electronics Co., Ltd.
 *
 */

#include "rk3568-toybrick-x0.dtsi"
#include "rk3568-linux.dtsi"
/delete-node/ &board_id;
/ {
	compatible = "rockchip,rk3568-toybrick-dev-linux-x0","rockchip,rk3568";
};
